## conf/distro/poky-rt.conf
```bitbake
require conf/distro/poky.conf

DISTRO = "poky-rt"
DISTRO_NAME = "Poky Realtime"

# kernel
PREFERRED_PROVIDER_virtual/kernel = "linux-evl"

# image
# INIT_MANAGER ?= "sysvinit"

# packages
PACKAGE_CLASSES = "package_ipk"
```

## conf/layer.conf
```bitbake
# We have a conf and classes directory, add to BBPATH
BBPATH .= ":${LAYERDIR}"

# We have recipes-* directories, add to BBFILES
BBFILES += "${LAYERDIR}/recipes-*/*/*.bb \
            ${LAYERDIR}/recipes-*/*/*.bbappend"

BBFILE_COLLECTIONS += "meta-imx-bsp"
BBFILE_PATTERN_meta-imx-bsp = "^${LAYERDIR}/"
BBFILE_PRIORITY_meta-imx-bsp = "6"

LAYERDEPENDS_meta-imx-bsp = "core"
LAYERSERIES_COMPAT_meta-imx-bsp = "scarthgap"
```

## conf/machine/ccbox.conf
```bitbake
#@TYPE: Machine
#@NAME: imx6q machine
#@DESCRIPTION: Machine configuration for running an ARMv7 system on imx6q

require conf/machine/include/imx6q.inc

# uboot
UBOOT_MACHINE ?= "mx6sabresd_defconfig"

# kernel
# KERNEL_DEVICETREE += " nxp/imx/imx6q-sabresd-ccbox.dtb"
```

## conf/machine/imx6.conf
```bitbake
#@TYPE: Machine
#@NAME: imx6q-sabrelite machine
#@DESCRIPTION: Machine configuration for running an ARMv7 system on imx6q-sabrelite

require conf/machine/include/arm/armv7a/tune-cortexa9.inc

KERNEL_IMAGETYPE = "zImage"

UBOOT_MACHINE ?= "imx_v6_v7_defconfig"

PREFERRED_PROVIDER_virtual/kernel ?= "linux-evl"

SERIAL_CONSOLES ?= "115200;ttymxc0"

IMAGE_FSTYPES += "tar.bz2 ext4"

# For runqemu
QB_SYSTEM_NAME = "qemu-system-arm"
QB_MACHINE = "-machine sabrelite"
QB_SMP ?= "-smp 4"
# For graphics to work we need to define the VGA device as well as the necessary USB devices
QB_GRAPHICS = "-device virtio-gpu-pci"
QB_OPT_APPEND = "-device qemu-xhci -device usb-tablet -device usb-kbd"
# Virtio Networking support
QB_TAP_OPT = "-netdev tap,id=net0,ifname=@TAP@,script=no,downscript=no"
QB_NETWORK_DEVICE = "-device virtio-net-device,netdev=net0,mac=@MAC@"
# Virtio block device
QB_ROOTFS_OPT = "-drive id=disk0,file=@ROOTFS@,if=none,format=raw -device virtio-blk-device,drive=disk0"
# Virtio serial console
QB_SERIAL_OPT = "-device virtio-serial-device -chardev null,id=virtcon -device virtconsole,chardev=virtcon"
QB_TCPSERIAL_OPT = "-device virtio-serial-device -chardev socket,id=virtcon,port=@PORT@,host=127.0.0.1,nodelay=on -device virtconsole,chardev=virtcon"

KMACHINE:qemuarm = "qemuarma9"
```

## conf/machine/include/imx6q.inc
```bitbake
#@TYPE: Machine
#@NAME: imx6q-sabrelite machine
#@DESCRIPTION: Machine configuration for running an ARMv7 system on imx6q-sabrelite

require conf/machine/include/arm/armv7a/tune-cortexa9.inc

# uboot
# UBOOT_MACHINE ?= "imx_v6_v7_defconfig"

# IMAGE_BOOT_FILES ?= "u-boot.${UBOOT_SUFFIX} ${SPL_BINARY} ${KERNEL_IMAGETYPE} ${KERNEL_DEVICETREE}"

# ${KERNEL_PACKAGE_NAME}

# extlinux
UBOOT_EXTLINUX = "1"
# UBOOT_EXTLINUX_LABELS ??= "default fallback"
UBOOT_EXTLINUX_DEFAULT_LABEL ??= "Linux Default"
# UBOOT_EXTLINUX_TIMEOUT ??= "3"
UBOOT_EXTLINUX_KERNEL_IMAGE:default ??= "../zImage"
UBOOT_EXTLINUX_MENU_DESCRIPTION:default ??= "Linux Default"
# UBOOT_EXTLINUX_KERNEL_IMAGE:fallback ??= "../zImage-fallback"
# UBOOT_EXTLINUX_MENU_DESCRIPTION:fallback ??= "Linux Fallback"

# UBOOT_EXTLINUX_ROOT = "root=/dev/mmcblk3p1"
# UBOOT_EXTLINUX_FDT = "../imx6q-sabresd-ccbox.dtb"
UBOOT_EXTLINUX_CONSOLE = "console=ttymxc0;115200" 
UBOOT_EXTLINUX_KERNEL_ARGS:append = " isolcpus=1 nohz_full=1"

# kernel
KERNEL_DEVICETREE ?= "nxp/imx/imx6q-sabrelite.dtb \
                      nxp/imx/imx6q-sabresd-ccbox.dtb \
                      "
MACHINE_ESSENTIAL_EXTRA_RDEPENDS += "kernel-image \
                                     kernel-devicetree \
                                     u-boot-extlinux \
                                     "

# image
SERIAL_CONSOLES ?= "115200;ttymxc0"

IMAGE_FSTYPES += "tar.bz2 ext4"

# poky setting
# DISTRO = "poky"
DISTRO_NAME = "Poky Realtime"

# image
# INIT_MANAGER ?= "sysvinit"

# packages
PACKAGE_CLASSES = "package_ipk"

# kernel
PREFERRED_PROVIDER_virtual/kernel ?= "linux-evl"
PREFERRED_PROVIDER_virtual/bootloader ?= "u-boot"

# don't install bootloader
# EXTRA_IMAGEDEPENDS += "virtual/bootloader"
```
